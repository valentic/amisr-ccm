## external/Config.in
```kconfig
source "$BR2_EXTERNAL_FCU_PATH/package/inn2/Config.in"
source "$BR2_EXTERNAL_FCU_PATH/package/libnfsidmap/Config.in"
source "$BR2_EXTERNAL_FCU_PATH/package/mgetty/Config.in"
source "$BR2_EXTERNAL_FCU_PATH/package/digitemp/Config.in"
source "$BR2_EXTERNAL_FCU_PATH/package/python-gpsd-py3/Config.in"
source "$BR2_EXTERNAL_FCU_PATH/package/python-ephem/Config.in"
source "$BR2_EXTERNAL_FCU_PATH/package/python-datatransport/Config.in"
source "$BR2_EXTERNAL_FCU_PATH/package/python-humanfriendly/Config.in"
source "$BR2_EXTERNAL_FCU_PATH/package/python-importlib-metadata/Config.in"
source "$BR2_EXTERNAL_FCU_PATH/package/python-linkify-it-py/Config.in"
source "$BR2_EXTERNAL_FCU_PATH/package/python-markdown-it-py/Config.in"
source "$BR2_EXTERNAL_FCU_PATH/package/python-mdit-py-plugins/Config.in"
source "$BR2_EXTERNAL_FCU_PATH/package/python-mdurl/Config.in"
source "$BR2_EXTERNAL_FCU_PATH/package/python-pytimeparse2/Config.in"
source "$BR2_EXTERNAL_FCU_PATH/package/python-rich/Config.in"
source "$BR2_EXTERNAL_FCU_PATH/package/python-sapphire-config/Config.in"
source "$BR2_EXTERNAL_FCU_PATH/package/python-speedtest-cli/Config.in"
source "$BR2_EXTERNAL_FCU_PATH/package/python-textual/Config.in"
source "$BR2_EXTERNAL_FCU_PATH/package/python-uc-micro-py/Config.in"
source "$BR2_EXTERNAL_FCU_PATH/package/set-dynamics-mode/Config.in"
source "$BR2_EXTERNAL_FCU_PATH/package/ts4900-utils/Config.in"
source "$BR2_EXTERNAL_FCU_PATH/package/ts-utils-7250v2/Config.in"
```

## external/configs/amisr-ccm-v1_defconfig
```kconfig
BR2_arm=y
BR2_cortex_a9=y
BR2_ARM_ENABLE_NEON=y
BR2_ARM_ENABLE_VFP=y
BR2_ARM_FPU_VFPV3=y
BR2_CCACHE=y
BR2_GLOBAL_PATCH_DIR="$(BR2_EXTERNAL_FCU_PATH)/board/amisr-ccm-v1/patches"
# BR2_PIC_PIE is not set
BR2_RELRO_NONE=y
BR2_TOOLCHAIN_EXTERNAL=y
BR2_TOOLCHAIN_EXTERNAL_BOOTLIN=y
BR2_TOOLCHAIN_EXTERNAL_BOOTLIN_ARMV7_EABIHF_GLIBC_STABLE=y
BR2_TARGET_GENERIC_HOSTNAME="amisr-ccm.tincan.net"
BR2_TARGET_GENERIC_ISSUE="AMISR CCM Embedded Monitoring System"
BR2_ROOTFS_DEVICE_CREATION_DYNAMIC_EUDEV=y
BR2_ROOTFS_DEVICE_TABLE="system/device_table.txt $(BR2_EXTERNAL_FCU_PATH)/board/amisr-ccm-v1/device_table.txt"
BR2_TARGET_GENERIC_ROOT_PASSWD="$$6$$PJ3GkVO.SBgX6sFM$$WOeZxLq9XrRHfxovnvl.VTy4aq3q.D3NhyKRwNvdZ2PkJKHt3zdRfUKe4ZebSB5JNFvRpDaZ7OoKJ2MLLBNpb1"
BR2_SYSTEM_BIN_SH_BASH=y
BR2_ENABLE_LOCALE_WHITELIST="C en_US en_US.utf8"
BR2_GENERATE_LOCALE="en_US"
BR2_ROOTFS_USERS_TABLES="$(BR2_EXTERNAL_FCU_PATH)/board/amisr-ccm-v1/users_table.txt"
BR2_ROOTFS_OVERLAY="$(BR2_EXTERNAL_FCU_PATH)/board/amisr-ccm-v1/overlay"
BR2_ROOTFS_POST_BUILD_SCRIPT="$(BR2_EXTERNAL_FCU_PATH)/board/amisr-ccm-v1/post-build.sh"
BR2_ROOTFS_POST_SCRIPT_ARGS="secretsdir=$(BR2_EXTERNAL_FCU_PATH)/../secrets ubootscript=$(BR2_EXTERNAL_FCU_PATH)/board/amisr-ccm-v1/tsinit.scr"
BR2_LINUX_KERNEL=y
BR2_LINUX_KERNEL_CUSTOM_TARBALL=y
BR2_LINUX_KERNEL_CUSTOM_TARBALL_LOCATION="$(call github,embeddedTS,linux-tsimx,ts-imx_4.9.11_1.0.0_ga)/linux-ts-imx_4.9.11_1.0.0_ga.tar.gz"
BR2_LINUX_KERNEL_DEFCONFIG="ts4900"
BR2_LINUX_KERNEL_UIMAGE=y
BR2_LINUX_KERNEL_UIMAGE_LOADADDR="0x10008000"
BR2_LINUX_KERNEL_DTS_SUPPORT=y
BR2_LINUX_KERNEL_INTREE_DTS_NAME="imx6q-ts4900 imx6q-ts4900-2 imx6q-ts4900-14 imx6q-ts4900-15 imx6q-ts4900-2d imx6q-ts4900-reve imx6q-ts4900-reve-2 imx6q-ts4900-reve-14 imx6q-ts4900-reve-15 imx6q-ts4900-reve-2d imx6q-ts7970 imx6q-ts7970-revf imx6q-ts7990-lxd-revb imx6q-ts7990-lxd imx6q-ts7990-microtips-revb imx6q-ts7990-microtips imx6q-ts7990-okaya-revb imx6q-ts7990-okaya imx6dl-ts4900 imx6dl-ts4900-2 imx6dl-ts4900-14 imx6dl-ts4900-15 imx6dl-ts4900-2d imx6dl-ts4900-reve imx6dl-ts4900-reve-2 imx6dl-ts4900-reve-14 imx6dl-ts4900-reve-15 imx6dl-ts4900-reve-2d imx6dl-ts7970 imx6dl-ts7970-revf imx6dl-ts7990-lxd-revb imx6dl-ts7990-lxd imx6dl-ts7990-microtips-revb imx6dl-ts7990-microtips imx6dl-ts7990-okaya-revb imx6dl-ts7990-okaya"
BR2_LINUX_KERNEL_INSTALL_TARGET=y
BR2_PACKAGE_BUSYBOX_CONFIG="$(BR2_EXTERNAL_FCU_PATH)/board/amisr-ccm-v1/busybox.config"
BR2_PACKAGE_BUSYBOX_SHOW_OTHERS=y
BR2_PACKAGE_XZ=y
BR2_PACKAGE_LSOF=y
BR2_PACKAGE_STRACE=y
BR2_PACKAGE_FLEX=y
BR2_PACKAGE_JQ=y
BR2_PACKAGE_AUTOFS=y
BR2_PACKAGE_E2FSPROGS=y
BR2_PACKAGE_E2FSPROGS_RESIZE2FS=y
BR2_PACKAGE_MMC_UTILS=y
BR2_PACKAGE_LINUX_FIRMWARE=y
BR2_PACKAGE_LINUX_FIRMWARE_TI_WL127X=y
BR2_PACKAGE_TS4900_FPGA=y
BR2_PACKAGE_DBUS=y
BR2_PACKAGE_GPSD=y
BR2_PACKAGE_GPSD_DEVICES="/dev/gps"
BR2_PACKAGE_GPSD_CLIENT_DEBUG=y
BR2_PACKAGE_GPSD_OLDSTYLE=y
BR2_PACKAGE_GPSD_PROFILING=y
BR2_PACKAGE_GPSD_UBX=y
BR2_PACKAGE_I2C_TOOLS=y
BR2_PACKAGE_MINICOM=y
BR2_PACKAGE_PARTED=y
BR2_PACKAGE_PICOCOM=y
BR2_PACKAGE_SETSERIAL=y
BR2_PACKAGE_UBOOT_TOOLS=y
BR2_PACKAGE_UBOOT_TOOLS_MKIMAGE=y
BR2_PACKAGE_UHUBCTL=y
BR2_PACKAGE_USBUTILS=y
BR2_PACKAGE_PYTHON_2TO3=y
BR2_PACKAGE_PYTHON_BZIP2=y
BR2_PACKAGE_PYTHON_BSDDB=y
BR2_PACKAGE_PYTHON_CURSES=y
BR2_PACKAGE_PYTHON_READLINE=y
BR2_PACKAGE_PYTHON_SQLITE=y
BR2_PACKAGE_PYTHON_CLICK=y
BR2_PACKAGE_PYTHON_DATEUTIL=y
BR2_PACKAGE_PYTHON_MODBUS_TK=y
BR2_PACKAGE_PYTHON_PYTZ=y
BR2_PACKAGE_PYTHON_REQUESTS=y
BR2_PACKAGE_CA_CERTIFICATES=y
BR2_PACKAGE_LIBGCRYPT=y
BR2_PACKAGE_POSTGRESQL=y
BR2_PACKAGE_POSTGRESQL_FULL=y
BR2_PACKAGE_LIBCURL=y
BR2_PACKAGE_LIBCURL_CURL=y
BR2_PACKAGE_LIBCURL_VERBOSE=y
BR2_PACKAGE_LIBTIRPC=y
BR2_PACKAGE_MPDECIMAL=y
BR2_PACKAGE_NCURSES_WCHAR=y
BR2_PACKAGE_NCURSES_TARGET_PROGS=y
BR2_PACKAGE_NCURSES_ADDITIONAL_TERMINFO="v/vt100"
BR2_PACKAGE_ARP_SCAN=y
BR2_PACKAGE_AUTOSSH=y
BR2_PACKAGE_CHRONY=y
BR2_PACKAGE_IFTOP=y
BR2_PACKAGE_IPTABLES=y
BR2_PACKAGE_IPTRAF_NG=y
BR2_PACKAGE_OPENRESOLV=y
BR2_PACKAGE_OPENSSH=y
BR2_PACKAGE_RSYNC=y
BR2_PACKAGE_WGET=y
BR2_PACKAGE_WPA_SUPPLICANT=y
BR2_PACKAGE_WPA_SUPPLICANT_AP_SUPPORT=y
BR2_PACKAGE_WPA_SUPPLICANT_WIFI_DISPLAY=y
BR2_PACKAGE_WPA_SUPPLICANT_MESH_NETWORKING=y
BR2_PACKAGE_WPA_SUPPLICANT_AUTOSCAN=y
BR2_PACKAGE_WPA_SUPPLICANT_EAP=y
BR2_PACKAGE_WPA_SUPPLICANT_DEBUG_SYSLOG=y
BR2_PACKAGE_WPA_SUPPLICANT_WPS=y
BR2_PACKAGE_WPA_SUPPLICANT_WPA3=y
BR2_PACKAGE_WPA_SUPPLICANT_CLI=y
BR2_PACKAGE_WPA_SUPPLICANT_WPA_CLIENT_SO=y
BR2_PACKAGE_WPA_SUPPLICANT_PASSPHRASE=y
BR2_PACKAGE_BASH_COMPLETION=y
BR2_PACKAGE_FILE=y
BR2_PACKAGE_LOGROTATE=y
BR2_PACKAGE_SUDO=y
BR2_PACKAGE_TMUX=y
BR2_PACKAGE_ATTR=y
BR2_PACKAGE_COREUTILS=y
BR2_PACKAGE_DCRON=y
BR2_PACKAGE_KEYUTILS=y
BR2_PACKAGE_PROCPS_NG=y
BR2_PACKAGE_RSYSLOG=y
BR2_PACKAGE_SUPERVISOR=y
BR2_PACKAGE_TAR=y
BR2_PACKAGE_UTIL_LINUX_BINARIES=y
BR2_PACKAGE_UTIL_LINUX_PARTX=y
BR2_PACKAGE_LESS=y
BR2_PACKAGE_NANO=y
BR2_PACKAGE_VIM=y
BR2_TARGET_ROOTFS_EXT2=y
BR2_TARGET_ROOTFS_EXT2_3=y
BR2_TARGET_ROOTFS_EXT2_SIZE="512M"
BR2_PACKAGE_HOST_GENIMAGE=y
BR2_PACKAGE_DATATRANSPORT=y
BR2_PACKAGE_PYTHON_GPSD_PY3=y
BR2_PACKAGE_PYTHON_PYEPHEM=y
BR2_PACKAGE_MGETTY=y
BR2_PACKAGE_DIGITEMP=y
```

## external/configs/amisr-ccm-v2_defconfig
```kconfig
BR2_arm=y
BR2_cortex_a9=y
BR2_ARM_ENABLE_NEON=y
BR2_ARM_ENABLE_VFP=y
BR2_ARM_FPU_VFPV3=y
BR2_TOOLCHAIN_BUILDROOT_MUSL=y
BR2_KERNEL_HEADERS_5_10=y
BR2_GCC_VERSION_10_X=y
BR2_TOOLCHAIN_BUILDROOT_CXX=y
BR2_GLOBAL_PATCH_DIR="$(BR2_EXTERNAL_FCU_PATH)/board/amisr-ccm-v2/patches"
# BR2_PIC_PIE is not set
BR2_RELRO_NONE=y
BR2_TARGET_GENERIC_HOSTNAME="amisr-ccm.tincan.net"
BR2_TARGET_GENERIC_ISSUE="AMISR CCM Monitoring System"
BR2_ROOTFS_DEVICE_CREATION_DYNAMIC_EUDEV=y
BR2_ROOTFS_DEVICE_TABLE="system/device_table.txt $(BR2_EXTERNAL_FCU_PATH)/board/amisr-ccm-v2/device_table.txt"
BR2_TARGET_GENERIC_ROOT_PASSWD="$$6$$PJ3GkVO.SBgX6sFM$$WOeZxLq9XrRHfxovnvl.VTy4aq3q.D3NhyKRwNvdZ2PkJKHt3zdRfUKe4ZebSB5JNFvRpDaZ7OoKJ2MLLBNpb1"
BR2_SYSTEM_ENABLE_NLS=y
BR2_ROOTFS_USERS_TABLES="$(BR2_EXTERNAL_FCU_PATH)/board/amisr-ccm-v2/users_table.txt"
BR2_ROOTFS_OVERLAY="$(BR2_EXTERNAL_FCU_PATH)/board/amisr-ccm-v2/overlay"
BR2_ROOTFS_POST_BUILD_SCRIPT="$(BR2_EXTERNAL_FCU_PATH)/board/amisr-ccm-v2/post-build.sh"
BR2_ROOTFS_POST_SCRIPT_ARGS="secretsdir=$(BR2_EXTERNAL_FCU_PATH)/../secrets ubootscript=$(BR2_EXTERNAL_FCU_PATH)/board/amisr-ccm-v2/tsinit.scr"
BR2_LINUX_KERNEL=y
BR2_LINUX_KERNEL_CUSTOM_TARBALL=y
BR2_LINUX_KERNEL_CUSTOM_TARBALL_LOCATION="$(call github,embeddedTS,linux-lts,v5.10.170.3-ts)/linux-v5.10.170.3-ts.tar.gz"
BR2_LINUX_KERNEL_USE_CUSTOM_CONFIG=y
BR2_LINUX_KERNEL_CUSTOM_CONFIG_FILE="$(BR2_EXTERNAL_FCU_PATH)/board/amisr-ccm-v2/kernel.config"
BR2_LINUX_KERNEL_UIMAGE=y
BR2_LINUX_KERNEL_LZO=y
BR2_LINUX_KERNEL_UIMAGE_LOADADDR="0x10008000"
BR2_LINUX_KERNEL_DTS_SUPPORT=y
BR2_LINUX_KERNEL_INTREE_DTS_NAME="imx6dl-ts4900-14 imx6dl-ts4900-2 imx6dl-ts4900 imx6dl-ts7970 imx6dl-ts7990-lxd imx6dl-ts7990-lxd-revb imx6dl-ts7990-microtips imx6dl-ts7990-microtips-revb imx6dl-ts7990-okaya imx6dl-ts7990-okaya-revb imx6q-ts4900-14 imx6q-ts4900-2 imx6q-ts4900 imx6q-ts7970 imx6q-ts7990-lxd imx6q-ts7990-lxd-revb imx6q-ts7990-microtips imx6q-ts7990-microtips-revb imx6q-ts7990-okaya imx6q-ts7990-okaya-revb"
BR2_LINUX_KERNEL_INSTALL_TARGET=y
BR2_PACKAGE_LINUX_TOOLS_CPUPOWER=y
BR2_PACKAGE_LINUX_TOOLS_GPIO=y
BR2_PACKAGE_LINUX_TOOLS_IIO=y
BR2_PACKAGE_BUSYBOX_CONFIG="$(BR2_EXTERNAL_FCU_PATH)/board/amisr-ccm-v2/busybox.config"
BR2_PACKAGE_BUSYBOX_SHOW_OTHERS=y
BR2_PACKAGE_BUSYBOX_WATCHDOG=y
BR2_PACKAGE_BUSYBOX_WATCHDOG_PERIOD="30"
BR2_PACKAGE_V4L2GRAB=y
BR2_PACKAGE_YAVTA=y
BR2_PACKAGE_UNRAR=y
BR2_PACKAGE_ZIP=y
BR2_PACKAGE_LSOF=y
BR2_PACKAGE_STRACE=y
BR2_PACKAGE_GIT=y
BR2_PACKAGE_JQ=y
BR2_PACKAGE_SED=y
BR2_PACKAGE_CIFS_UTILS=y
BR2_PACKAGE_CIFS_UTILS_SMBTOOLS=y
BR2_PACKAGE_E2FSPROGS=y
BR2_PACKAGE_E2FSPROGS_RESIZE2FS=y
BR2_PACKAGE_EXFAT=y
BR2_PACKAGE_EXFAT_UTILS=y
BR2_PACKAGE_EXFATPROGS=y
BR2_PACKAGE_MMC_UTILS=y
BR2_PACKAGE_NFS_UTILS=y
BR2_PACKAGE_NFS_UTILS_NFSV4=y
BR2_PACKAGE_NFS_UTILS_RPC_LOCKD=y
BR2_PACKAGE_NFS_UTILS_RPC_RQUOTAD=y
BR2_PACKAGE_SSHFS=y
BR2_PACKAGE_FSWEBCAM=y
BR2_PACKAGE_LINUX_FIRMWARE=y
BR2_PACKAGE_LINUX_FIRMWARE_ATHEROS_10K_QCA9377=y
BR2_PACKAGE_LINUX_FIRMWARE_TI_WL127X=y
BR2_PACKAGE_TS4900_FPGA=y
BR2_PACKAGE_WILC3000_FIRMWARE=y
BR2_PACKAGE_WILINK_BT_FIRMWARE=y
BR2_PACKAGE_DBUS_PYTHON=y
BR2_PACKAGE_GPSD=y
BR2_PACKAGE_GPSD_DEVICES="/dev/gps"
BR2_PACKAGE_GPSD_CLIENT_DEBUG=y
BR2_PACKAGE_GPSD_PYTHON=y
BR2_PACKAGE_GPSD_UBX=y
BR2_PACKAGE_I2C_TOOLS=y
BR2_PACKAGE_LM_SENSORS=y
BR2_PACKAGE_LSHW=y
BR2_PACKAGE_MEMTESTER=y
BR2_PACKAGE_MEMTOOL=y
BR2_PACKAGE_MINICOM=y
BR2_PACKAGE_PARTED=y
BR2_PACKAGE_PICOCOM=y
BR2_PACKAGE_PPS_TOOLS=y
BR2_PACKAGE_RTC_TOOLS=y
BR2_PACKAGE_SETSERIAL=y
BR2_PACKAGE_SPI_TOOLS=y
BR2_PACKAGE_STATSERIAL=y
BR2_PACKAGE_UBOOT_TOOLS=y
BR2_PACKAGE_UBOOT_TOOLS_MKIMAGE=y
BR2_PACKAGE_UBOOT_TOOLS_MKENVIMAGE=y
BR2_PACKAGE_UHUBCTL=y
BR2_PACKAGE_USBUTILS=y
BR2_PACKAGE_WILC_DRIVER=y
BR2_PACKAGE_WILC_DRIVER_SPI=y
BR2_PACKAGE_PYTHON3_PY_PYC=y
BR2_PACKAGE_PYTHON3_2TO3=y
BR2_PACKAGE_PYTHON3_BERKELEYDB=y
BR2_PACKAGE_PYTHON3_BZIP2=y
BR2_PACKAGE_PYTHON3_CURSES=y
BR2_PACKAGE_PYTHON3_DECIMAL=y
BR2_PACKAGE_PYTHON3_READLINE=y
BR2_PACKAGE_PYTHON3_SQLITE=y
BR2_PACKAGE_PYTHON3_XZ=y
BR2_PACKAGE_PYTHON_CLICK=y
BR2_PACKAGE_PYTHON_MODBUS_TK=y
BR2_PACKAGE_PYTHON_NUMPY=y
BR2_PACKAGE_PYTHON_PIP=y
BR2_PACKAGE_PYTHON_PROMPT_TOOLKIT=y
BR2_PACKAGE_PYTHON_PSYCOPG2=y
BR2_PACKAGE_PYTHON_PYMODBUS=y
BR2_PACKAGE_PYTHON_PYTZ=y
BR2_PACKAGE_PYTHON_REQUESTS=y
BR2_PACKAGE_PYTHON_SQLALCHEMY=y
BR2_PACKAGE_PYTHON_WEBSOCKET_CLIENT=y
BR2_PACKAGE_LZ4=y
BR2_PACKAGE_CA_CERTIFICATES=y
BR2_PACKAGE_GNUTLS=y
BR2_PACKAGE_LIBGCRYPT=y
BR2_PACKAGE_LIBSSH=y
BR2_PACKAGE_LIBSSH_OPENSSL=y
BR2_PACKAGE_LIBSSH2=y
BR2_PACKAGE_LIBSSH2_OPENSSL=y
BR2_PACKAGE_LIBOPENSSL_BIN=y
BR2_PACKAGE_POSTGRESQL_FULL=y
BR2_PACKAGE_DTC=y
BR2_PACKAGE_DTC_PROGRAMS=y
BR2_PACKAGE_LIBGPIOD=y
BR2_PACKAGE_LIBGPIOD_TOOLS=y
BR2_PACKAGE_LIBIIO=y
BR2_PACKAGE_LIBIIO_TESTS=y
BR2_PACKAGE_LIBIIO_BINDINGS_PYTHON=y
BR2_PACKAGE_LIBFASTJSON=y
BR2_PACKAGE_LIBLOGGING=y
BR2_PACKAGE_LIBCURL=y
BR2_PACKAGE_LIBCURL_CURL=y
BR2_PACKAGE_LIBCURL_VERBOSE=y
BR2_PACKAGE_LIBMICROHTTPD=y
BR2_PACKAGE_APR_UTIL=y
BR2_PACKAGE_CMOCKA=y
BR2_PACKAGE_LIBESTR=y
BR2_PACKAGE_NCURSES_WCHAR=y
BR2_PACKAGE_NCURSES_TARGET_PROGS=y
BR2_PACKAGE_NCURSES_ADDITIONAL_TERMINFO="v/vt100"
BR2_PACKAGE_PCRE=y
BR2_PACKAGE_HAVEGED=y
BR2_PACKAGE_ARP_SCAN=y
BR2_PACKAGE_ATFTP=y
BR2_PACKAGE_AUTOSSH=y
BR2_PACKAGE_BLUEZ_TOOLS=y
BR2_PACKAGE_BLUEZ5_UTILS=y
BR2_PACKAGE_BLUEZ5_UTILS_OBEX=y
BR2_PACKAGE_BLUEZ5_UTILS_CLIENT=y
BR2_PACKAGE_BLUEZ5_UTILS_MONITOR=y
BR2_PACKAGE_BLUEZ5_UTILS_TOOLS=y
BR2_PACKAGE_BLUEZ5_UTILS_DEPRECATED=y
BR2_PACKAGE_BLUEZ5_UTILS_PLUGINS_HID=y
BR2_PACKAGE_BRIDGE_UTILS=y
BR2_PACKAGE_CAN_UTILS=y
BR2_PACKAGE_CHRONY=y
BR2_PACKAGE_CHRONY_DEBUG_LOGGING=y
BR2_PACKAGE_DNSMASQ=y
BR2_PACKAGE_ETHTOOL=y
BR2_PACKAGE_HOSTAPD=y
BR2_PACKAGE_HOSTAPD_WPA3=y
BR2_PACKAGE_IFTOP=y
BR2_PACKAGE_IPERF3=y
BR2_PACKAGE_IPTABLES=y
BR2_PACKAGE_IPTABLES_NFTABLES=y
BR2_PACKAGE_IPTRAF_NG=y
BR2_PACKAGE_IPUTILS=y
BR2_PACKAGE_IW=y
BR2_PACKAGE_NETCAT=y
BR2_PACKAGE_NFTABLES=y
BR2_PACKAGE_RSYNC=y
BR2_PACKAGE_WGET=y
BR2_PACKAGE_WIRELESS_REGDB=y
BR2_PACKAGE_WIRELESS_TOOLS=y
BR2_PACKAGE_WPA_SUPPLICANT=y
BR2_PACKAGE_WPA_SUPPLICANT_AP_SUPPORT=y
BR2_PACKAGE_WPA_SUPPLICANT_WIFI_DISPLAY=y
BR2_PACKAGE_WPA_SUPPLICANT_MESH_NETWORKING=y
BR2_PACKAGE_WPA_SUPPLICANT_OVERRIDES=y
BR2_PACKAGE_WPA_SUPPLICANT_AUTOSCAN=y
BR2_PACKAGE_WPA_SUPPLICANT_HOTSPOT=y
BR2_PACKAGE_WPA_SUPPLICANT_DEBUG_SYSLOG=y
BR2_PACKAGE_WPA_SUPPLICANT_WPS=y
BR2_PACKAGE_WPA_SUPPLICANT_WPA3=y
BR2_PACKAGE_WPA_SUPPLICANT_CLI=y
BR2_PACKAGE_WPA_SUPPLICANT_WPA_CLIENT_SO=y
BR2_PACKAGE_WPA_SUPPLICANT_PASSPHRASE=y
BR2_PACKAGE_BASH=y
BR2_PACKAGE_AT=y
BR2_PACKAGE_BASH_COMPLETION=y
BR2_PACKAGE_FILE=y
BR2_PACKAGE_LOGROTATE=y
BR2_PACKAGE_SUDO=y
BR2_PACKAGE_TMUX=y
BR2_PACKAGE_ATTR=y
BR2_PACKAGE_COREUTILS=y
BR2_PACKAGE_DCRON=y
BR2_PACKAGE_HTOP=y
BR2_PACKAGE_KMOD_TOOLS=y
BR2_PACKAGE_PROCPS_NG=y
BR2_PACKAGE_SUPERVISOR=y
BR2_PACKAGE_TAR=y
BR2_PACKAGE_UTIL_LINUX_BINARIES=y
BR2_PACKAGE_UTIL_LINUX_FSCK=y
BR2_PACKAGE_UTIL_LINUX_HWCLOCK=y
BR2_PACKAGE_UTIL_LINUX_IPCS=y
BR2_PACKAGE_UTIL_LINUX_PARTX=y
BR2_PACKAGE_UTIL_LINUX_VIPW=y
BR2_PACKAGE_UTIL_LINUX_ZRAMCTL=y
BR2_PACKAGE_LESS=y
BR2_PACKAGE_NANO=y
BR2_PACKAGE_VIM=y
BR2_TARGET_ROOTFS_TAR_XZ=y
BR2_PACKAGE_HOST_KMOD_XZ=y
BR2_PACKAGE_INN2=y
BR2_PACKAGE_MGETTY=y
BR2_PACKAGE_PYTHON_GPSD_PY3=y
BR2_PACKAGE_PYTHON_EPHEM=y
BR2_PACKAGE_PYTHON_DATATRANSPORT=y
BR2_PACKAGE_PYTHON_TEXTUAL=y
BR2_PACKAGE_TS4900_UTILS=y
```

## external/external/python-pytimeparse2/Config.in
```kconfig
config BR2_PACKAGE_PYTHON_PYTIMEPARSE2
	bool "python-pytimeparse2"
	help
	  Time expression parser.

	  https://github.com/onegreyonewhite/pytimeparse2
```

## external/external/python-texttable/Config.in
```kconfig
config BR2_PACKAGE_PYTHON_TEXTTABLE
	bool "python-texttable"
	help
	  module to create simple ASCII tables.

	  https://github.com/foutaise/texttable/
```

## external/package/python-datatransport/Config.in
```kconfig
config BR2_PACKAGE_PYTHON_DATATRANSPORT
	bool "python-datatransport"
	select BR2_PACKAGE_PYTHON_DATEUTIL # runtime
	select BR2_PACKAGE_PYTHON_IMPORTLIB_RESOURCES13PYTHON_VERSION310 # runtime
	select BR2_PACKAGE_PYTHON_PYTIMEPARSE2 # runtime
	select BR2_PACKAGE_PYTHON_SAPPHIRE_CONFIG # runtime
	select BR2_PACKAGE_PYTHON_TEXTTABLE # runtime
	help
        Data Transport Network
```

## external/package/python-ephem/Config.in
```kconfig
config BR2_PACKAGE_PYTHON_EPHEM
	bool "python-ephem"
	help
	  Compute positions of the planets and stars.

	  http://rhodesmill.org/pyephem/
```

## external/package/python-humanfriendly/Config.in
```kconfig
config BR2_PACKAGE_PYTHON_HUMANFRIENDLY
	bool "python-humanfriendly"
	help
	  Human friendly output for text interfaces using Python.

	  https://humanfriendly.readthedocs.io
```

## external/package/python-linkify-it-py/Config.in
```kconfig
config BR2_PACKAGE_PYTHON_LINKIFY_IT_PY
	bool "python-linkify-it-py"
	select BR2_PACKAGE_PYTHON_UC_MICRO_PY # runtime
	help
	  Links recognition library with FULL unicode support.

	  https://github.com/tsutsu3/linkify-it-py
```

## external/package/python-mdurl/Config.in
```kconfig
config BR2_PACKAGE_PYTHON_MDURL
	bool "python-mdurl"
	help
	  Markdown URL utilities.

	  https://github.com/executablebooks/mdurl
```
