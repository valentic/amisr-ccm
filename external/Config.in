## external/package/python-pymodbus34/Config.in
```kconfig
config BR2_PACKAGE_PYTHON_PYMODBUS34
	bool "python-pymodbus34"
	select BR2_PACKAGE_PYTHON_SIX # runtime
	select BR2_PACKAGE_PYTHON_SERIAL # runtime
	help
	  Pymodbus is a full Modbus protocol implementation. (Release 3.4)

	  https://github.com/riptideio/pymodbus
```

## external/package/python-rich/Config.in
```kconfig
config BR2_PACKAGE_PYTHON_RICH
	bool "python-rich"
    select BR2_PACKAGE_PYTHON_TYPING_EXTENSIONS # runtime
    select BR2_PACKAGE_PYTHON_PYGMENTS # runtime
    select BR2_PACKAGE_PYTHON_MARKDOWN_IT_PY # runtime
    select BR2_PACKAGE_PYTHON_LINKIFY_IT_PY # runtime
    select BR2_PACKAGE_PYTHON_MDIT_PY_PLUGINS # runtime
	help
	  Render rich text, tables, progress bars, syntax
	  highlighting, markdown and more to the terminal.

	  https://github.com/Textualize/rich
```

## external/package/python-sapphire-config/Config.in
```kconfig
config BR2_PACKAGE_PYTHON_SAPPHIRE_CONFIG
	bool "python-sapphire-config"
	select BR2_PACKAGE_PYTHON_DATEUTIL # runtime
	select BR2_PACKAGE_PYTHON_HUMANFRIENDLY # runtime
	select BR2_PACKAGE_PYTHON_PYTIMEPARSE2 # runtime
	help
	  Sapphire Configuration Parser.

	  https://github.com/valentic/sapphire-config
```

## external/package/python-speedtest-cli/Config.in
```kconfig
config BR2_PACKAGE_PYTHON_SPEEDTEST_CLI
	bool "python-speedtest-cli"
	help
	  Command line interface for testing internet bandwidth using
	  speedtest.net.

	  https://github.com/sivel/speedtest-cli
```

## external/package/python-uc-micro-py/Config.in
```kconfig
config BR2_PACKAGE_PYTHON_UC_MICRO_PY
	bool "python-uc-micro-py"
	help
	  Micro subset of unicode data files for linkify-it-py
	  projects.

	  https://github.com/tsutsu3/uc.micro-py
```
